/dts-v1/;

#include <espressif/esp32s3/esp32s3_wroom_n16r8.dtsi>
#include <zephyr/dt-bindings/input/input-event-codes.h>
#include <zephyr/dt-bindings/input/esp32-touch-sensor-input.h>
#include <espressif/partitions_0x0_amp.dtsi>
#include "from_scratch-pinctrl.dtsi"

/ 
    model = "From Scratch Board";
    compatible = "spas_tech,from_scratch";

    aliases {
        i2c-0 = &i2c0;
        watchdog0 = &wdt0;
    };

    chosen {
        zephyr,sram = &sram1;
        zephyr,console = &uart0;
        zephyr,shell-uart = &uart0;
        zephyr,flash = &flash0;
        zephyr,code-partition = &slot0_partition;
    };
};

