## CMakeLists.txt
```
cmake_minimum_required(VERSION 3.20.0)

list(APPEND BOARD_ROOT ${CMAKE_CURRENT_SOURCE_DIR})
find_package(Zephyr REQUIRED HINTS $ENV{ZEPHYR_BASE})
project(l02_hello_world)

target_sources(app PRIVATE src/main.cpp)
```

## prj.conf
```kconfig
CONFIG_GPIO=y

CONFIG_LED_STRIP=y
CONFIG_SPI=y
CONFIG_WS2812_STRIP_SPI=y

CONFIG_SERIAL=y
CONFIG_CONSOLE=y
CONFIG_UART_CONSOLE=y
CONFIG_UART_LINE_CTRL=y
CONFIG_STDOUT_CONSOLE=y

CONFIG_LOG=y
```

## src/main.cpp
```c
#include <zephyr/kernel.h>
#include <zephyr/device.h>
#include <zephyr/drivers/led_strip.h>
#include <zephyr/sys/util.h>
#include <zephyr/logging/log.h>

// Get the device pointer for the LED strip from the devicetree alias
#define LED_NODE DT_ALIAS(led_strip)
static const struct device *led_strip = DEVICE_DT_GET(LED_NODE);

// Define a pixel buffer for one LED (GRB order)
static led_rgb pixel_struct = {.r = 0x00, .g = 0x00, .b = 0x00 }; // Blue, Red, Green

LOG_MODULE_REGISTER(main, LOG_LEVEL_INF);

int main(void)
{
    int ret;

    // Verify the LED strip device is ready
    if (!device_is_ready(led_strip)) {
        return 0;
    }

    while (1) {
        // Set LED to Red
        pixel_struct.r = 0x8F; // Red
        pixel_struct.g = 0x00; // Green
        pixel_struct.b = 0x00; // Blue
        
        ret = led_strip_update_rgb(led_strip, &pixel_struct, 1);
        LOG_INF("LED state: Red\n");

        if (ret) {
            return 0;
        }
        k_msleep(1000);

        // Set LED to Green
        pixel_struct.r = 0x00; // Red
        pixel_struct.g = 0x8F; // Green
        pixel_struct.b = 0x00; // Blue

        ret = led_strip_update_rgb(led_strip, &pixel_struct, 1);
        LOG_INF("LED state: Green\n");

        if (ret) {
            return 0;
        }
        k_msleep(1000);

        // Set LED to Blue
        pixel_struct.r = 0x00; // Red
        pixel_struct.g = 0x00; // Green
        pixel_struct.b = 0x8F; // Blue

        ret = led_strip_update_rgb(led_strip, &pixel_struct, 1);
        LOG_INF("LED state: Blue\n");
        
        if (ret) {
            return 0;
        }

        k_msleep(1000);
    }

    return 0;
}
```
