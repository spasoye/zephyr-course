## app/boards/copy_kit/Kconfig.copy_kit
```kconfig
# Copyright (c) 2024 Espressif Systems (Shanghai) Co., Ltd.
# SPDX-License-Identifier: Apache-2.0

config BOARD_COPY_KIT
	select SOC_ESP32S3_WROOM_N16R8
	select SOC_ESP32S3_PROCPU if BOARD_COPY_KIT_ESP32S3_PROCPU
	select SOC_ESP32S3_APPCPU if BOARD_COPY_KIT_ESP32S3_APPCPU
```
