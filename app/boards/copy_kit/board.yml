## app/boards/copy_kit/board.yml
```yaml
board:
  name: copy_kit
  full_name: Copy Kit ESP32-S3
  vendor: spas-tech
  socs:
  - name: esp32s3
```

## boards/copy_kit/Kconfig.defconfig
```kconfig
if BOARD_COPY_KIT_ESP32S3_PROCPU

config BOARD
    default "copy_kit"

endif # BOARD_COPY_KIT_ESP32S3_PROCPU
```

## boards/from_scratch/board.yml
```yaml
board:
  name: from_scratch
  full_name: From Scratch Board
  vendor: spas-tech
  socs:
  - name: esp32s3
```

## samples/l06_custom_driver/drivers/spas_driver/Kconfig
```kconfig
menuconfig SPAS_DRIVER
    bool "Lesson 6 Custom Driver"
    default y
    depends on DT_HAS_SPAS_DRIVER_ENABLED
    # select GPIO
    help
      Enable custom driver for the Lecture 6 homework
```
